/*
 * Copyright (c) 2025
 * SPDX-License-Identifier: Apache-2.0
 *
 * CC1352P1 LaunchXL board overlay for the IWRL6322 raw-ADC run test.
 *
 * Pin wiring (connect to the IWRL6322 breakout via BoosterPack header):
 *
 *  BP Header  DIO   Signal              IWRL6322 pin
 *  ──────────────────────────────────────────────────
 *  BP-7       DIO10  SPI_CLK (SCK)      CLK
 *  BP-15      DIO9   SPI_MOSI           MOSI
 *  BP-14      DIO8   SPI_MISO           MISO
 *  BP-18      DIO15  SPI_CSN (GPIO CS)  CSN  ← driven by GPIO, not SPI0_FSS hw
 *  BP-38      DIO19  nRESET             nRESET
 *  BP-36      DIO7   SPI_BUSY           SPI_BUSY
 *  BP-5       DIO22  WAKE_UP            WAKE_UP
 *  BP-29      DIO6   PRESENCE_DETECT    PRESENCE_DETECT
 *  BP-xx      DIO11  SOP0               SOP0  (pull-down → SPI boot mode)
 *  BP-xx      DIO20  SOP1               SOP1  (pull-down → SPI boot mode)
 */

&spi0 {
	pinctrl-0 = <&spi0_sck_default &spi0_mosi_default &spi0_miso_default>;
	pinctrl-names = "default";
	cs-gpios = <&gpio0 15 GPIO_ACTIVE_LOW>;

	mmwave: mmwave@0 {
		compatible = "ti,iwrl6322";
		reg = <0>;
		spi-max-frequency = <1000000>; /* 1 MHz */

		nreset-gpios          = <&gpio0 19 GPIO_ACTIVE_HIGH>;
		spi-busy-gpios        = <&gpio0 7 GPIO_ACTIVE_HIGH>;
		wake-up-gpios         = <&gpio0 22 (GPIO_ACTIVE_HIGH | GPIO_PULL_DOWN)>;
		presence-detect-gpios = <&gpio0 6 GPIO_ACTIVE_HIGH>;
		sop0-gpios            = <&gpio0 11 (GPIO_ACTIVE_HIGH | GPIO_PULL_DOWN)>;
		sop1-gpios            = <&gpio0 20 (GPIO_ACTIVE_HIGH | GPIO_PULL_DOWN)>;
	};
};
